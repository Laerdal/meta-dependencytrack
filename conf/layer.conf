## conf/layer.conf
```bitbake
# SPDX-License-Identifier: MIT
# Copyright 2022 BG Networks, Inc.

# We have a conf and classes directory, add to BBPATH
BBPATH .= ":${LAYERDIR}"

# Register Python library path (required since Scarthgap)
addpylib ${LAYERDIR}/lib json_utils

BBFILE_COLLECTIONS += "dependency-track"
BBFILE_PATTERN_dependency-track = "^${LAYERDIR}/"
BBFILE_PRIORITY_dependency-track = "6"

LAYERSERIES_COMPAT_dependency-track = "honister kirkstone scarthgap"
```
